// SPDX-License-Identifier: GPL-2.0-only
/*
 * ER-TFT3.95-1 on an SPI bus. Include this inside the SPI controller node of your
 * board DTS, e.g.
 *
 *     &spi1 {
 *         status = "okay";
 *         #include "er-tft395.dtsi"
 *     };
 *
 * !! GPIO phandles below are PLACEHOLDERS (&gpio0 N): wire them to your board. !!
 * Pin roles come from the tutorial wiring:
 *   LT7680 SPI : CS, SCK, MISO, MOSI (SPI controller pins), RES
 *   NV3052 init: 3 free GPIOs, bit-banged by the driver (tutorial: CS 14, SDI 12, SCK 13)
 */
display@0 {
	compatible = "eastrising,er-tft3.95-1", "levetop,lt7680";
	reg = <0>;
	spi-max-frequency = <31250000>;		/* 31.25 MHz worked on a Pi 4; tutorial uses 20 MHz; mode 0 */

	reset-gpios = <&gpio0 16 GPIO_ACTIVE_LOW>;
	panel-cs-gpios = <&gpio0 14 GPIO_ACTIVE_LOW>;
	panel-sck-gpios = <&gpio0 13 GPIO_ACTIVE_HIGH>;
	panel-sdi-gpios = <&gpio0 12 GPIO_ACTIVE_HIGH>;
	backlight-gpios = <&gpio0 26 GPIO_ACTIVE_HIGH>;	/* BL_CONTROL; delete if BL is tied to 3.3V */

	width-mm = <70>;			/* approximate; fix from the panel datasheet */
	height-mm = <70>;

	panel-timing {
		/* Values from LCD.h of the tutorial. The LT7680 PLL derives SCLK = N MHz,
		 * so clock-frequency is rounded to whole MHz (36 MHz in the tutorial). */
		clock-frequency = <36000000>;
		hactive = <720>;
		vactive = <720>;
		hfront-porch = <15>;
		hback-porch = <80>;
		hsync-len = <5>;
		vfront-porch = <15>;
		vback-porch = <20>;
		vsync-len = <5>;
		hsync-active = <0>;
		vsync-active = <0>;
		de-active = <1>;
		pixelclk-active = <0>;
	};
};
