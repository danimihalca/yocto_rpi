## meta-bbq20kbd/conf/layer.conf
```bitbake
BBPATH .= ":${LAYERDIR}"
BBFILES += "${LAYERDIR}/recipes-*/*/*.bb ${LAYERDIR}/recipes-*/*/*.bbappend"
BBFILE_COLLECTIONS += "bbq20kbd"
BBFILE_PATTERN_bbq20kbd = "^${LAYERDIR}/"
BBFILE_PRIORITY_bbq20kbd = "6"
LAYERDEPENDS_bbq20kbd = "core raspberrypi"
LAYERSERIES_COMPAT_bbq20kbd = "scarthgap"
```

## meta-rpi4-rauc/conf/layer.conf
```bitbake
BBPATH .= ":${LAYERDIR}"

BBFILES += "${LAYERDIR}/recipes-*/*/*.bb ${LAYERDIR}/recipes-*/*/*.bbappend"

BBFILE_COLLECTIONS += "rpi4-rauc"
BBFILE_PATTERN_rpi4-rauc = "^${LAYERDIR}/"
BBFILE_PRIORITY_rpi4-rauc = "10"

LAYERSERIES_COMPAT_rpi4-rauc = "scarthgap"
LAYERDEPENDS_rpi4-rauc = "core raspberrypi rauc"
```
